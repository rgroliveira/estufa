## main/Kconfig.projbuild
```kconfig
menu "CONFIGURACAO ESTUFA"
    config ESTUFA_SETPOINT_DEFAULT
        int "Setpoint Padrão da Estufa"
        range 0 100
        default 30
        help
            Define o setpoint padrão da estufa em graus Celsius.
    config ESTUFA_MAX_TEMP
        int "Temperatura Máxima da Estufa"
        range 0 100
        default 50
        help
            Define a temperatura máxima que a estufa pode atingir em graus Celsius.
    config ESTUFA_MIN_TEMP
        int "Temperatura Mínima da Estufa"
        range 0 100
        default 15
        help
            Define a temperatura mínima que a estufa pode atingir em graus Celsius.
endmenu
```

## sdkconfig.defaults
```kconfig
# Configuracoes Franzininho WiFi
CONFIG_IDF_TARGET="esp32s2"
CONFIG_IDF_TARGET_ESP32S2=y
CONFIG_ESP_CONSOLE_USB_CDC=y
CONFIG_ESPTOOLPY_FLASHSIZE_4MB=y

# OLED SSD1306 no LAB01 Franzininho
CONFIG_ESP32S2_DEFAULT_CPU_FREQ_240=y
CONFIG_ESP32S2_DEFAULT_CPU_FREQ_MHZ=240
CONFIG_SCL_GPIO=9
CONFIG_SDA_GPIO=8
CONFIG_RESET_GPIO=-1
```
